## boards/shields/trackpaddemo/Kconfig.defconfig
```kconfig
if SHIELD_TRACKPADDEMO

CONFIG_ZMK_BOARD_COMPAT=y

config ZMK_KEYBOARD_NAME
    default "TRACKPAD DEMO"

config I2C
    default y

config INPUT_TPS43
    default y

config ZMK_POINTING
    default y

endif
```

## config/west.yml
```yaml
manifest:
  remotes:
    - name: zmkfirmware
      url-base: https://github.com/zmkfirmware
    - name: beekeeb
      url-base: https://github.com/beekeeb
  projects:
    - name: zmk
      remote: zmkfirmware
      revision: main
      import: app/west.yml
    - name: zmk_driver_azoteq
      remote: beekeeb
      revision: master
  self:
    path: config
```
